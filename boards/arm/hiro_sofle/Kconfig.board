## boards/arm/hiro_sofle/Kconfig.board
```kconfig
#
# Copyright (c) 2024 The ZMK Contributors
# SPDX-License-Identifier: MIT
#

config BOARD_HIRO_SOFLE_LEFT
    bool "hiro_sofle left"
    depends on SOC_NRF52840_QIAA

config BOARD_HIRO_SOFLE_RIGHT
    bool "hiro_sofle right"
    depends on SOC_NRF52840_QIAA
```

## config/west.yml
```yaml
manifest:
  remotes:
    - name: zmkfirmware
      url-base: https://github.com/zmkfirmware
    - name: gpeye
      url-base: https://github.com/GPeye
  projects:
    - name: hiro_sofle
      url: https://github.com/hirokiraj/hiro-sofle
      revision: master
    - name: mario-peripheral-animation
      remote: gpeye
      revision: main 
    - name: zmk
      remote: zmkfirmware
      revision: main
      import: app/west.yml
  self:
    path: config
```
